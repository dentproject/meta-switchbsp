## conf/layer.conf
```bitbake
# We have a conf and classes directory, add to BBPATH
BBPATH .= ":${LAYERDIR}"

# We have a packages directory, add to BBFILES
BBFILES += "${LAYERDIR}/recipes-*/*/*.bb \
            ${LAYERDIR}/recipes-*/*/*.bbappend"

BBFILE_COLLECTIONS += "switchbsp"
BBFILE_PATTERN_switchbsp := "^${LAYERDIR}/"
BBFILE_PRIORITY_switchbsp = "5"

LAYERDEPENDS_switchbsp = "core"
LAYERSERIES_COMPAT_switchbsp = "styhead"
```

## conf/machine/arm64-all.conf
```bitbake
require conf/machine/include/common.inc
require conf/machine/include/arm/arch-armv8a.inc

PREFERRED_PROVIDER_virtual/kernel ?= "linux-dentproject"
KERNEL_IMAGETYPE ?= "Image"

MACHINE_FEATURES = "pci serial"

KERNEL_DEVICETREE = " \
    marvell/accton-as4224.dtb \
    marvell/accton-as5114.dtb \
    marvell/accton-as4564-26p.dtb \
    marvell/delta-tn48m.dtb \
    marvell/delta-tn4810m.dtb \
    marvell/delta-tn48m-dn.dtb \
    marvell/delta-tn4810m-dn.dtb \
    marvell/delta-tn48m2-swdev.dtb \
    marvell/delta-tn48m.dtb \
"

# MACHINE_EXTRA_RRECOMMENDS += ""
MACHINE_ESSENTIAL_EXTRA_RRECOMMENDS += "kernel-modules"
```

## conf/machine/arm64-delta-tn48m-r0.conf
```bitbake
require conf/machine/include/common.inc
require conf/machine/include/arm64-common.inc
```

## conf/machine/delta-tn48m.conf
```bitbake
require conf/machine/include/common.inc
require conf/machine/include/mvebu-common.inc

PREFERRED_PROVIDER_virtual/kernel ?= "linux-dentproject"
KERNEL_IMAGETYPE ?= "Image"

KERNEL_DEVICETREE = " \
    marvell/delta-tn48m.dtb \
    marvell/delta-tn48m-dn.dtb \
    marvell/delta-tn48m2-swdev.dtb \
"

# MACHINE_EXTRA_RRECOMMENDS += ""
MACHINE_ESSENTIAL_EXTRA_RRECOMMENDS += "kernel-modules"

SERIAL_CONSOLES = "115200;ttyS0"
```

## conf/machine/include/arm64-common.inc
```bitbake
PREFERRED_PROVIDER_virtual/kernel ?= "linux-yocto"

KMACHINE = "arm64-switch"
KERNEL_IMAGETYPE ?= "Image"

require conf/machine/include/arm/arch-armv8a.inc

MACHINE_FEATURES += "pci serial"
```

## conf/machine/include/common.inc
```bitbake
MACHINEOVERRIDES =. "switch:"

SERIAL_CONSOLE ?= "115200 ttyS0"

INITRAMFS_IMAGE_BUNDLE ?= "1"
```

## conf/machine/include/mvebu-common.inc
```bitbake
require conf/machine/include/arm/arch-armv8a.inc
SOC_FAMILY:prepend = "mvebu:"
require conf/machine/include/soc-family.inc

KERNEL_DEVICETREE = " \
    marvell/accton-as4224.dtb \
    marvell/accton-as5114.dtb \
    marvell/accton-as4564-26p.dtb \
    marvell/delta-tn48m.dtb \
    marvell/delta-tn4810m.dtb \
    marvell/delta-tn48m-dn.dtb \
    marvell/delta-tn4810m-dn.dtb \
    marvell/delta-tn48m2-swdev.dtb \
    marvell/delta-tn48m.dtb \
"

SERIAL_CONSOLE ?= "115200 ttyS0"
```

## conf/machine/include/x86_64-common.inc
```bitbake
PREFERRED_PROVIDER_virtual/kernel ?= "linux-yocto"

KMACHINE = "x86_64-switch"
KERNEL_IMAGETYPE ?= "bzImage"

DEFAULTTUNE ?= "corei7-64"
require conf/machine/include/x86/tune-corei7.inc
require conf/machine/include/x86/x86-base.inc

MACHINE_FEATURES += "pcbios efi"
```

## conf/machine/x86_64-accton_as4630_54pe-r0.conf
```bitbake
require conf/machine/include/common.inc
require conf/machine/include/x86_64-common.inc
```
